## build/Kconfig/arch/Kconfig
```kconfig
# Load Zephyr Arch Kconfig descriptions.
osource "C:/Users/gusta/OneDrive/Documents/GitHub/zephyr/arch/x86/Kconfig"
osource "C:/Users/gusta/OneDrive/Documents/GitHub/zephyr/arch/xtensa/Kconfig"
osource "C:/Users/gusta/OneDrive/Documents/GitHub/zephyr/arch/sparc/Kconfig"
osource "C:/Users/gusta/OneDrive/Documents/GitHub/zephyr/arch/riscv/Kconfig"
osource "C:/Users/gusta/OneDrive/Documents/GitHub/zephyr/arch/posix/Kconfig"
osource "C:/Users/gusta/OneDrive/Documents/GitHub/zephyr/arch/nios2/Kconfig"
osource "C:/Users/gusta/OneDrive/Documents/GitHub/zephyr/arch/mips/Kconfig"
osource "C:/Users/gusta/OneDrive/Documents/GitHub/zephyr/arch/arm64/Kconfig"
osource "C:/Users/gusta/OneDrive/Documents/GitHub/zephyr/arch/arm/Kconfig"
osource "C:/Users/gusta/OneDrive/Documents/GitHub/zephyr/arch/arc/Kconfig"
```

## build/Kconfig/boards/Kconfig.defconfig
```kconfig
# Load Zephyr board defconfig descriptions.
osource "C:/Users/gusta/OneDrive/Documents/GitHub/zephyr/boards/qemu/cortex_a53/Kconfig.defconfig"
```

## build/Kconfig/boards/Kconfig.qemu_cortex_a53
```kconfig
# Load board Kconfig descriptions.
osource "C:/Users/gusta/OneDrive/Documents/GitHub/zephyr/boards/qemu/cortex_a53/Kconfig.qemu_cortex_a53"
```

## build/Kconfig/boards/Kconfig.sysbuild
```kconfig
# Load Sysbuild board Kconfig descriptions.
osource "C:/Users/gusta/OneDrive/Documents/GitHub/zephyr/boards/qemu/cortex_a53/Kconfig.sysbuild"
```
